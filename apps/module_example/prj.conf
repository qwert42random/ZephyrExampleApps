## CMakeLists.txt
```
cmake_minimum_required(VERSION 3.22)

set(BOARD stm32f4_disco)

set(DTC_OVERLAY_FILE ${CMAKE_CURRENT_SOURCE_DIR}/minimal.overlay)
set(ZEPHYR_EXTRA_MODULES "${WEST_TOPDIR}/extra_modules/gpio")

# Finds and loads packages from external project.
# Use the zephyr path.
find_package(Zephyr REQUIRED HINTS $ENV{ZEPHYR_BASE})
project(module_example)

target_sources(app PRIVATE src/main.c)
```

## prj.conf
```kconfig
CONFIG_GPIO_DRIVER=y
```

## src/main.c
```c
#include <zephyr/kernel.h>
#include <stdio.h>

#include "gpio_driver.h"

struct Gpio green = {
    .reg = DT_STRING_TOKEN(DT_PATH(test, green_light), gpio_port),
    .pin = DT_PROP(DT_PATH(test, green_light), pin),
    .pull = DT_STRING_TOKEN(DT_PATH(test, green_light), pull_type),
    .mode = DT_STRING_TOKEN(DT_PATH(test, green_light), output)
};

struct Gpio usr_button = {
    .reg = DT_STRING_TOKEN(DT_PATH(test, button), gpio_port),
    .pin = DT_PROP(DT_PATH(test, button), pin),
    .pull = DT_STRING_TOKEN(DT_PATH(test, button), pull_type),
    .mode = DT_STRING_TOKEN(DT_PATH(test, button), output)
};

int main(void) {
    init_gpio(green);
    init_gpio(usr_button);

    int pin_state = 1;
    write_pin(green, pin_state);

    while(1) {

        if (read_pin(usr_button)) {

            pin_state = !pin_state;
            write_pin(green, pin_state);
            printf("Button pressed\n");

            k_msleep(300);
            while (read_pin(usr_button));
        }
    }

    return 0;
}
```

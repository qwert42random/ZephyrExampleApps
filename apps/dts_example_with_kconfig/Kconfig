## apps/dts_example_with_kconfig/Kconfig
```kconfig
source "Kconfig.zephyr"

menuconfig TEST_DRIVER
    bool "Use test drivers"
    depends on DT_HAS_EXAMPLE_TEST_ENABLED
    help
        Import test drivers

if TEST_DRIVER

config ALT_PRINT_FUNC
    bool "Use alt print function"
    default n
    help
        Use alternative print function.

config ALT_TEST_FUNC
    bool "Use alt test function"
    default n
    help
        Use alternative test function.
endif
```

## apps/dts_no_modules/dts/bindings/example,test.yaml
```yaml
# Description of the device
description: Example device tree binding

# Compatibility string that matches the one in the Devicetree source and
# DT_DRV_COMPAT macro in the driver source code
compatible: "example,test"

# Define the required node properties
properties:
  first-var:
    type: int
    required: true
  second-var:
    type: int
    required: true
  third-var:
    type: int
    required: false
```

## extra_modules/custom/dts/bindings/custom,test.yaml
```yaml
# Description of the device
description: Custom Test

# Compatibility string that matches the one in the Devicetree source and
# DT_DRV_COMPAT macro in the driver source code
compatible: "custom,test"

# Define the required node properties
properties:
  first-var:
    type: int
    required: true
  second-var:
    type: int
    required: true
  third-var:
    type: int
    required: false
```

## extra_modules/gpio/gpio_drivers/Kconfig
```kconfig
# Create a new option in menuconfig
config GPIO_DRIVER
    bool "GPIO driver"
    default n           # Set the driver to be disabled by default.
    depends on DT_HAS_CUSTOM_GPIO_ENABLED
    help
        Enable the example GPIO driver
```

## modules/custom/drivers/gpio/Kconfig
```kconfig
# Create a new option in menuconfig
config GPIO_DRIVER
    bool "GPIO driver"
    default n           # Set the driver to be disabled by default.
    help
        Enable the custom button driver
```

## modules/custom/drivers/test/Kconfig
```kconfig
# Create a new option in menuconfig
# menu "Test driver options"

# menu "Test driver configurations"
#     depends on DT_HAS_CUSTOM_TEST_ENABLED

menuconfig TEST_DRIVER
    bool "Use test drivers"
    depends on DT_HAS_CUSTOM_TEST_ENABLED
    help
        Import test drivers

if TEST_DRIVER

config ALT_PRINT_FUNC
    bool "Use alt print function"
    default n
    help
        Use alternative print function.

config ALT_TEST_FUNC
    bool "Use alt test function"
    default n
    help
        Use alternative test function.
endif
```

## modules/custom/dts/bindings/custom,compatible.yaml
```yaml
# Description of the device
description: Custom Compatible

# Compatibility string that matches the one in the Devicetree source and
# DT_DRV_COMPAT macro in the driver source code
compatible: "custom,compatible"
```

## modules/custom/dts/bindings/custom,gpio.yaml
```yaml
# Description of the device
description: Custom GPIO

# Compatibility string that matches the one in the Devicetree source and
# DT_DRV_COMPAT macro in the driver source code
compatible: "custom,gpio"

# Define the required node properties
properties:
  gpio_port:
    type: string
    required: true
    enum:
      - "A"
      - "B"
      - "C"
      - "D"
      - "E"
      - "F"
      - "G"
      - "H"
      - "I"
      - "J"

  pin:
    type: int
    required: true
  
  pull_type:
    type: string
    required: true
    enum:
      - "none"
      - "pull_up"
      - "pull_down"
  
  output:
    type: string
    required: true
    enum:
      - "input"
      - "output"
```

## modules/custom/dts/bindings/custom,test.yaml
```yaml
# Description of the device
description: Custom Test

# Compatibility string that matches the one in the Devicetree source and
# DT_DRV_COMPAT macro in the driver source code
compatible: "custom,test"

# Define the required node properties
properties:
  firstVar:
    type: int
    required: true
  secondVar:
    type: int
    required: true
```
